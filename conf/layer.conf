## conf/layer.conf
```bitbake
# We have a conf and classes directory, add to BBPATH
BBPATH := "${LAYERDIR}:${BBPATH}"

# We have a packages directory, add to BBFILES
BBFILES := "${BBFILES} ${LAYERDIR}/recipes-*/*/*.bb \
            ${LAYERDIR}/recipes-*/*/*.bbappend"

BBFILE_COLLECTIONS += "metagw"
BBFILE_PATTERN_metagw := "^${LAYERDIR}/"
BBFILE_PRIORITY_metagw = "8"

# We have a LICENSE_DIR to search for additional licenses
WR_EXTRA_LIC_DIR = "${LAYERDIR}/files/common-licenses"
LICENSE_PATH[vardepsexclude] += "WR_EXTRA_LIC_DIR"
LICENSE_PATH += "${WR_EXTRA_LIC_DIR}"

# We have a pre-populated downloads directory, add to PREMIRRORS
PREMIRRORS_append := "\
     git://.*/.* file://${LAYERDIR}/downloads/ \n \
     svn://.*/.* file://${LAYERDIR}/downloads/ \n \
     ftp://.*/.* file://${LAYERDIR}/downloads/ \n \
     http://.*/.* file://${LAYERDIR}/downloads/ \n \
     https://.*/.* file://${LAYERDIR}/downloads/ \n"
```

## scripts/lib/wic/canned-wks/cube-desktop-flatpak-runtime-intel-corei7-64.wks
```
part /boot/efi --source rawcopy --sourceparams="file=cube-desktop-flatpak-runtime-intel-corei7-64_efi.otaimg"  --ondisk mmcblk --fstype=vfat --label boot --active --align 4
part / --source rawcopy --sourceparams="file=cube-desktop-flatpak-runtime-intel-corei7-64.otaimg" --ondisk mmcblk --fstype=ext4 --label root --align 4
part /var --source rawcopy --sourceparams="file=cube-desktop-flatpak-runtime-intel-corei7-64_var.otaimg"  --ondisk mmcblk --fstype=ext4 --label fluxdata --active --align 4
```

## scripts/lib/wic/canned-wks/cube-desktop-flatpak-sdk-intel-corei7-64.wks
```
part /boot/efi --source rawcopy --sourceparams="file=cube-desktop-flatpak-runtime-intel-corei7-64_efi.otaimg"  --ondisk mmcblk --fstype=vfat --label boot --active --align 4
part / --source rawcopy --sourceparams="file=cube-desktop-flatpak-sdk-intel-corei7-64.otaimg" --ondisk mmcblk --fstype=ext4 --label root --align 4
part /var/lib/flatpak --ondisk mmcblk --fstype=ext4 --label fluxdata --align 4 --size 16
```

## scripts/lib/wic/canned-wks/cube-gw-intel-corei7-64.wks
```
part /boot --source bootimg-partition --ondisk mmcblk --fstype=vfat --label boot --active --align 4 --size 16
part / --source rawcopy --sourceparams="file=cube-gw-intel-corei7-64.otaimg" --ondisk mmcblk --fstype=ext4 --label root --align 4
part /var/lib/flatpak --ondisk mmcblk --fstype=ext4 --label fluxdata --align 4 --size 16
```
